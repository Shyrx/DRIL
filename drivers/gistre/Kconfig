## drivers/gistre/Kconfig
```kconfig
#
# Should describe what the driver can do
#

menu "MFRC522 GISTRE drivers support"

config MFRC522_EMU
	bool "GISTRE MFRC522 emulator"
        bool "test" # TODO: implement for palier 1
	help
      Emulates a single MFRC522 NFC card reader device.
      This device usually uses SPI, but the emulation uses the regmap
      API and hides it behind a fake I2C device; which should not
      matter in any way when communicating with it.

endmenu
```

## drivers/gistre/gistre_card/Kconfig
```kconfig
config MFRC522_DRIVER
        bool enable
        depends on MFRC522_EMU
        help
      This module is used to communicate with a mfrc522 card.
      It enables reading and writing from/into the card.
      To do so write `mem_read` or `mem_write:<len of data>:<data>` into this module.
      You can read/write a maximum of 25 octets by command.
      You can enable different level of logging using `debug:<on/off>:<[info|trace|warn|extra|error]+>`.
      You can also enable/disable all level of logging using `debug:<on/off>`
      and see currently enable logging level with `debug:status`.

        string debug
        imply enable
        help
      Set which logs level the driver should have enabled on startup.
      Must be a : separated list containing unique values among <[info|trace|warn|extra|error]>.
      Can also be equal to all to enable all logs.
      Example: --debug info:trace
      By default, only the error logs are enabled.

        bool quiet
        imply enable
        help
      Disable all debugs, has priority over the debug parameter

        int nb_devices
        imply enable
        help
      The number of devices to create when initializing the module
```
